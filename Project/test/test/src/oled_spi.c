#include "oled_spi.h"

const uchar8 F6x8[][6] =
{
    { 0x00, 0x00, 0x00, 0x00, 0x00, 0x00 }, //sp0
    { 0x00, 0x00, 0x00, 0x2f, 0x00, 0x00 }, // !1
    { 0x00, 0x00, 0x07, 0x00, 0x07, 0x00 }, // "2
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    { 0x14, 0x14, 0x14, 0x14, 0x14, 0x14 } // horiz lines91
};


//======================================================
// 128X64OLED液晶底层驱动[8X16]字体库
// 设计者: Guokaiyi
// 描 述: [8X16]西文字符的字模数据 (纵向取模,字节倒序)
// !"#$%&'()*+,-./0123456789:;<=>?@ABCDEFGHIJKLMNOPQRSTUVWXYZ[\]^_`abcdefghijklmnopqrstuvwxyz{|}~
//======================================================
const uchar8 F8X16[]=
{
    0x00,0x00,0x00,0x00,0x00,0x00,0x00,0x00,0x00,0x00,0x00,0x00,0x00,0x00,0x00,0x00,// 0
    0x00,0x00,0x00,0xF8,0x00,0x00,0x00,0x00,0x00,0x00,0x00,0x33,0x30,0x00,0x00,0x00,//!1
    0x00,0x10,0x0C,0x06,0x10,0x0C,0x06,0x00,0x00,0x00,0x00,0x00,0x00,0x00,0x00,0x00,//"2
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    0x00,0x06,0x01,0x01,0x02,0x02,0x04,0x04,0x00,0x00,0x00,0x00,0x00,0x00,0x00,0x00,//~94
};

void Write_SPI_Command(unsigned char data){
    PDout(4) = 0;
    SPI_ReadWriteByte(HW_SPI0, HW_CTAR0, data, HW_SPI_CS0, kSPI_PCS_ReturnInactive);
}
void Write_SPI_Data(unsigned char data){
    PDout(4) = 1;
    SPI_ReadWriteByte(HW_SPI0, HW_CTAR0, data, HW_SPI_CS0, kSPI_PCS_ReturnInactive);
}
/*****************************************************************************
 函 数 名 : LED_WrDat
 功能描述 : 向OLED写数据
 输入参数 : uchar8 ucData
 输出参数 : NONE
 返 回 值 : NONE
*****************************************************************************/
void LED_WrDat(uchar8 ucData)
{
 Write_SPI_Data(ucData);
}

/*****************************************************************************
 函 数 名 : LED_WrCmd
 功能描述 : 向OLED写命令
 输入参数 : uchar8 ucCmd
 输出参数 : NONE
 返 回 值 : NONE
*****************************************************************************/
void LED_WrCmd(uchar8 ucCmd)
{
   Write_SPI_Command(ucCmd);
}

/*****************************************************************************
 函 数 名 : LED_SetPos
 功能描述 : 设置坐标
 输入参数 : uchar8 ucIdxX
             uchar8 ucIdxY
 输出参数 : NONE
 返 回 值 : NONE
*****************************************************************************/
void LED_SetPos(uchar8 ucIdxX, uchar8 ucIdxY)
{
    if(ucIdxX<132)ucIdxX += 2;
    LED_WrCmd(0xb0 + ucIdxY);
    LED_WrCmd(((ucIdxX & 0xf0) >> 4) | 0x10);
    LED_WrCmd((ucIdxX & 0x0f) | 0x00);
}

/*****************************************************************************
 函 数 名 : LED_Fill
 功能描述 : 对全屏写入同一个字符函数
             如 LED_Fill(0x01); 对于某一位0为不亮 1为亮
            ------------------------------------------------------
                                共128列
                  1 1 1
              共 0 0 0
              8 0 0 0
              组 0 ……0 ………… 0
              字 0 0 0
              符 0 0 0
              即 0 0 0
              8 0 0 0
              页 1 1 1
              64 0 0 0
              行 . . .
                  . . ………… .
                  . . .
                  . . .
                  0 0 0
            ------------------------------------------------------
 输入参数 : uchar8 ucData
 输出参数 : NONE
 返 回 值 : NONE
*****************************************************************************/
void LED_Fill(uchar8 ucData)
{
    uchar8 ucPage,ucColumn;

    for(ucPage = 0; ucPage < 8; ucPage++)
    {
        LED_WrCmd(0xb0 + ucPage); //0xb0+0~7表示页0~7
        LED_WrCmd(0x00); //0x00+0~16表示将128列分成16组其地址在某组中的第几列
        LED_WrCmd(0x10); //0x10+0~16表示将128列分成16组其地址所在第几组
        for(ucColumn = 0; ucColumn < 130; ucColumn++)
        {
            LED_WrDat(ucData);
        }
    }
}

void SetStartColumn(uchar8 ucData)
{
    LED_WrCmd(0x00+ucData % 16); // Set Lower Column Start Address for Page Addressing Mode
                                   // Default => 0x00
    LED_WrCmd(0x10+ucData / 16); // Set Higher Column Start Address for Page Addressing Mode
                                   // Default => 0x10
}

void SetAddressingMode(uchar8 ucData)
{
    LED_WrCmd(0x20); // Set Memory Addressing Mode
    LED_WrCmd(ucData); // Default => 0x02
                            // 0x00 => Horizontal Addressing Mode
                            // 0x01 => Vertical Addressing Mode
                            // 0x02 => Page Addressing Mode
}

void SetColumnAddress(uchar8 a, uchar8 b)
{
    LED_WrCmd(0x21); // Set Column Address
    LED_WrCmd(a); // Default => 0x00 (Column Start Address)
    LED_WrCmd(b); // Default => 0x7F (Column End Address)
}

void SetPageAddress(uchar8 a, uchar8 b)
{
    LED_WrCmd(0x22); // Set Page Address
    LED_WrCmd(a); // Default => 0x00 (Page Start Address)
    LED_WrCmd(b); // Default => 0x07 (Page End Address)
}

void SetStartLine(uchar8 ucData)
{
    LED_WrCmd(0x40|ucData); // Set Display Start Line
                            // Default => 0x40 (0x00)
}

void SetContrastControl(uchar8 ucData)
{
    LED_WrCmd(0x81); // Set Contrast Control
    LED_WrCmd(ucData); // Default => 0x7F
}

void SetChargePump(uchar8 ucData)
{
    LED_WrCmd(0x8D); // Set Charge Pump
    LED_WrCmd(0x10|ucData); // Default => 0x10
                            // 0x10 (0x00) => Disable Charge Pump
                            // 0x14 (0x04) => Enable Charge Pump
}

void SetSegmentRemap(uchar8 ucData)
{
    LED_WrCmd(0xA0|ucData); // Set Segment Re-Map
                            // Default => 0xA0
                            // 0xA0 (0x00) => Column Address 0 Mapped to SEG0
                            // 0xA1 (0x01) => Column Address 0 Mapped to SEG127
}

void SetEntireDisplay(uchar8 ucData)
{
    LED_WrCmd(0xA4|ucData); // Set Entire Display On / Off
                            // Default => 0xA4
                            // 0xA4 (0x00) => Normal Display
                            // 0xA5 (0x01) => Entire Display On
}

void SetInverseDisplay(uchar8 ucData)
{
    LED_WrCmd(0xA6|ucData); // Set Inverse Display On/Off
                            // Default => 0xA6
                            // 0xA6 (0x00) => Normal Display
                            // 0xA7 (0x01) => Inverse Display On
}

void SetMultiplexRatio(uchar8 ucData)
{
    LED_WrCmd(0xA8); // Set Multiplex Ratio
    LED_WrCmd(ucData); // Default => 0x3F (1/64 Duty)
}

void SetDisplayOnOff(uchar8 ucData)
{
    LED_WrCmd(0xAE|ucData); // Set Display On/Off
                            // Default => 0xAE
                            // 0xAE (0x00) => Display Off
                            // 0xAF (0x01) => Display On
}

void SetStartPage(uchar8 ucData)
{
    LED_WrCmd(0xB0|ucData); // Set Page Start Address for Page Addressing Mode
                            // Default => 0xB0 (0x00)
}

void SetCommonRemap(uchar8 ucData)
{
    LED_WrCmd(0xC0|ucData); // Set COM Output Scan Direction
                            // Default => 0xC0
                            // 0xC0 (0x00) => Scan from COM0 to 63
                            // 0xC8 (0x08) => Scan from COM63 to 0
}

void SetDisplayOffset(uchar8 ucData)
{
    LED_WrCmd(0xD3); // Set Display Offset
    LED_WrCmd(ucData); // Default => 0x00
}

void SetDisplayClock(uchar8 ucData)
{
    LED_WrCmd(0xD5); // Set Display Clock Divide Ratio / Oscillator Frequency
    LED_WrCmd(ucData); // Default => 0x80
                            // D[3:0] => Display Clock Divider
                            // D[7:4] => Oscillator Frequency
}

void SetPrechargePeriod(uchar8 ucData)
{
    LED_WrCmd(0xD9); // Set Pre-Charge Period
    LED_WrCmd(ucData); // Default => 0x22 (2 Display Clocks [Phase 2] / 2 Display Clocks [Phase 1])
                            // D[3:0] => Phase 1 Period in 1~15 Display Clocks
                            // D[7:4] => Phase 2 Period in 1~15 Display Clocks
}

void SetCommonConfig(uchar8 ucData)
{
    LED_WrCmd(0xDA); // Set COM Pins Hardware Configuration
    LED_WrCmd(0x02|ucData); // Default => 0x12 (0x10)
                            // Alternative COM Pin Configuration
                            // Disable COM Left/Right Re-Map
}

void SetVCOMH(uchar8 ucData)
{
    LED_WrCmd(0xDB); // Set VCOMH Deselect Level
    LED_WrCmd(ucData); // Default => 0x20 (0.77*VCC)
}

void SetNop(void)
{
    LED_WrCmd(0xE3); // Command for No Operation
}

/*****************************************************************************
 函 数 名 : LED_P8x16Str
 功能描述 : 写入一组8x16标准ASCII字符串
 输入参数 : UCHAR8 ucIdxX 为显示的横坐标0~120
             UCHAR8 ucIdxY 为页范围0～3
             UCHAR8 ucDataStr[] 要显示的字符串
 输出参数 : NONE
 返 回 值 : NONE
*****************************************************************************/
void LED_P8x16Str(uchar8 ucIdxX, uchar8 ucIdxY, uchar8 ucDataStr[])
{
    uchar8 i, j, ucDataTmp;

    ucIdxY <<= 1;

    for (j = 0; ucDataStr[j] != '\0'; j++)
    {
        ucDataTmp = ucDataStr[j] - 32;
        if(ucIdxX > 120)
        {
            ucIdxX = 0;
            ucIdxY += 2;
        }
        LED_SetPos(ucIdxX, ucIdxY);

        for(i = 0; i < 8; i++)
        {
            LED_WrDat(F8X16[(ucDataTmp << 4) + i]);
        }

        LED_SetPos(ucIdxX, ucIdxY + 1);

        for(i = 0; i < 8; i++)
        {
            LED_WrDat(F8X16[(ucDataTmp << 4) + i + 8]);
        }
        ucIdxX += 8;

    }

    return;
}

/*****************************************************************************
 函 数 名 : LED_Init
 功能描述 : OLED初始化
 输入参数 : void
 输出参数 : NONE
 返 回 值 : NONE
*****************************************************************************/
void initOLED(void)
{
    for(int i = 1;i < 6; i++)
        GPIO_QuickInit(HW_GPIOD, i, kGPIO_Mode_OPP);

    SPI_QuickInit(SPI0_SCK_PD01_SOUT_PD02_SIN_PD03, kSPI_CPOL0_CPHA0, 8*1000*1000);

    PDout(5) = 0;
    DelayMs(1);
    PDout(5) = 1;
    //Reset and Wait

    SetDisplayOnOff(0x00); // Display Off (0x00/0x01)
    SetDisplayClock(0x80); // Set Clock as 100 Frames/Sec
    SetMultiplexRatio(0x3F); // 1/64 Duty (0x0F~0x3F)
    SetDisplayOffset(0x00); // Shift Mapping RAM Counter (0x00~0x3F)
    SetStartLine(0x00); // Set Mapping RAM Display Start Line (0x00~0x3F)
    SetChargePump(0x04); // Enable Embedded DC/DC Converter (0x00/0x04)
    SetAddressingMode(0x02); // Set Page Addressing Mode (0x00/0x01/0x02)
    SetSegmentRemap(0x01); // Set SEG/Column Mapping 0x00左右反置 0x01正常
    SetCommonRemap(0x00); // Set COM/Row Scan Direction 0x00上下反置 0x08正常
    SetCommonConfig(0x10); // Set Sequential Configuration (0x00/0x10)
    SetContrastControl(0xCF); // Set SEG Output Current
    SetPrechargePeriod(0xF1); // Set Pre-Charge as 15 Clocks & Discharge as 1 Clock
    SetVCOMH(0x40); // Set VCOM Deselect Level
    SetEntireDisplay(0x00); // Disable Entire Display On (0x00/0x01)
    SetInverseDisplay(0x00); // Disable Inverse Display On (0x00/0x01)
    SetDisplayOnOff(0x01); // Display On (0x00/0x01)
    LED_Fill(0x00); // 初始清屏
    LED_SetPos(0,0);

    printf("OLED init OK\r\n");
    return;
}

